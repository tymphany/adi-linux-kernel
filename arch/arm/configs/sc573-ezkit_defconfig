## drivers/media/platform/adi/Kconfig
```kconfig
config VIDEO_ADI_CAPTURE
	tristate "ADI SC5XX  Video Capture Driver"
	depends on VIDEO_V4L2 && (ARCH_SC58X || ARCH_SC57X) && I2C
	depends on HAS_DMA
	select VIDEOBUF2_DMA_CONTIG
	help
	  V4L2 bridge driver for ADI SC5XX video capture device.
	  Choose PPI or EPPI as its interface.

	  To compile this driver as a module, choose M here: the
	  module will be called adi_capture.

config VIDEO_ADI_PPI
	tristate
	depends on VIDEO_ADI_CAPTURE
	default VIDEO_ADI_CAPTURE
```

## drivers/pinctrl/adi/Kconfig
```kconfig
# SPDX-License-Identifier: GPL-2.0-only

config PINCTRL_ADSP
	bool
	depends on OF
	select PINMUX
	select GENERIC_PINCONF

config PINCTRL_ADSP_SC598
	bool "ADSP-SC598 pinctrl driver"
	depends on ARCH_SC59X_64
	select PINCTRL_ADSP
	help
	  Say Y here to enable the ADSP-SC598 pinctrl driver. This is required for
	  correct peripheral functionality on the SoC.
```

## drivers/staging/icc/Kconfig
```kconfig
#
# Intercore communication protocol and impelementation
#

menuconfig ICC_DRIVER
	bool "icc driver"
	depends on !SMP && !BFIN_L2_DCACHEABLE
	help
	  the icc driver is a device driver that control the DSP devices,
	  and bridges the the program runing on DSPs and linux user applications
if ICC_DRIVER
config	ICC
	bool "icc protocol"
	default Y
	help
	  ICC protocol, a shared memory based protocol for communication between
	  linux core and DSP core
config ICC_DEBUG
	bool "icc debug"
	default N
	help
	  ICC verbose debug messages
endif
```

## drivers/tym/ioex/Kconfig
```kconfig
menu "IO expander drivers"

config IOEX_AW9110
	tristate "awinic I2C IO expander aw9110"
	select NEW_LEDS
	select LEDS_CLASS
	select LEDS_TRIGGERS
	select REGMAP_I2C
	default y
	help
	  if you say yes here you can get support for awinic
	  aw9110b or aw9110c I2C device.

endmenu
```

## sound/soc/adi/Kconfig
```kconfig
config SND_SOC_ADI
	tristate "Audio support for Analog Devices reference designs"
	depends on MICROBLAZE || ARCH_ZYNQ || COMPILE_TEST
	help
	  Audio support for various reference designs by Analog Devices.

config SND_SOC_ADI_AXI_I2S
	tristate "AXI-I2S support"
	depends on SND_SOC_ADI
	select SND_SOC_GENERIC_DMAENGINE_PCM
	select REGMAP_MMIO
	help
	  ASoC driver for the Analog Devices AXI-I2S softcore peripheral.

config SND_SOC_ADI_AXI_SPDIF
	tristate "AXI-SPDIF support"
	depends on SND_SOC_ADI
	select SND_SOC_GENERIC_DMAENGINE_PCM
	select REGMAP_MMIO
	help
	  ASoC driver for the Analog Devices AXI-SPDIF softcore peripheral.

config SND_SC5XX_PCM
	tristate "SoC Audio for the ADI SC5XX chip"
	depends on ARCH_SC58X || ARCH_SC57X
	select SND_SC5XX_SPORT
	help
	  Say Y or M if you want to add support for codecs attached to
	  the SC5XX SPORT (synchronous serial ports) interface in I2S
	  or TDM mode.
	  You will also need to select the audio interfaces to support below.

config SND_SC5XX_ADAU1979
	tristate "Support for the ADAU1979 board on SC5XX ezkit board"
	depends on SND_SC5XX_PCM && I2C
	select SND_SC5XX_MACHINE
	select SND_SOC_ADI_SC5XX_I2S
	select SND_SOC_ADAU1977_I2C
	help
	Say Y if you want to add support for the Analog Devices ADAU1979
        board connected to the SC5XX ezkit board.

config SND_SC5XX_ADAU1962
	tristate "Support for the ADAU1962 board on SC5XX ezkit board"
	depends on SND_SC5XX_PCM && I2C
	select SND_SC5XX_MACHINE
	select SND_SOC_ADI_SC5XX_I2S
	select SND_SOC_ADAU1962_I2C
	help
	Say Y if you want to add support for the Analog Devices ADAU1962
        board connected to the SC5XX ezkit board.

config SND_SC5XX_SPORT
	tristate
	depends on ARCH_SC58X || ARCH_SC57X
	help
	SPORT interface driver for SC5XX audio, audio data are sent and
	received through the SPORT DMA buffers
	Most audio devices on SC5xx requires this
	Say Y or M if you want to enable this

config SND_SOC_ADI_SC5XX_I2S
	tristate
	depends on ARCH_SC58X || ARCH_SC57X
	help
	Describes the Digital Audio Interface format, which is physcally
	built on the SPORT
	Most audio devices on SC5xx requires this
	Say Y or M if you want to enable this

config SND_SC5XX_MACHINE
	tristate
	depends on ARCH_SC58X || ARCH_SC57X
	help
	Describes the ASoC Machine driver for ADI SC5XX based boards
	Audio devices on SC5xx requires this
	Say Y or M if you want to enable this
```
