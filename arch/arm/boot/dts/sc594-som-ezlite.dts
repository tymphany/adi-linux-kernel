/*
 * Device tree for ADI sc594-som-ezlite board
 *
 * Copyright 2014 - 2020 Analog Devices Inc.
 *
 * Licensed under the GPL-2 or later.
 *
 */

/dts-v1/;

#include "sc594-som.dtsi"

/ {
	model = "ADI sc594-som-ezlite";
	compatible = "adi,sc594-som-ezlite", "adi,sc59x";
};

&i2c2 {
	/* Add in AD5587 Expander */
	/* Add in ADAU1372 Codec */
};


&emac0 {
	/* Add in ADIN1300 */
};
