/*
 * Copyright (c) 2021 Analog Devices Incorporated
 * Author: Nathan Barrett-Morrison <nathan.morrison@timesys.com>
 */

/dts-v1/;

#include "sc598-som.dtsi"

/ {
	model = "ADI 64-bit SC598 SOM EZ Lite";
	compatible = "adi,sc598-som-ezlite", "adi,sc59x-64";
};

&i2c2 {
	/* Add in AD5587 Expander */
	/* Add in ADAU1372 Codec */
};

&emac0 {
	/* Add in ADIN1300 */
};

